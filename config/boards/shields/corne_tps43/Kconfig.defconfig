## config/boards/shields/corne_tps43/Kconfig.defconfig
```kconfig
if SHIELD_CORNE_TPS43_DONGLE

config ZMK_KEYBOARD_NAME
    default "Corne TPS43"

config ZMK_SPLIT_ROLE_CENTRAL
    default y

endif

if SHIELD_CORNE_TPS43_DONGLE || SHIELD_CORNE_TPS43_LEFT || SHIELD_CORNE_TPS43_RIGHT

config ZMK_SPLIT
    default y

endif
```

## config/boards/shields/corne_tps43/Kconfig.shield
```kconfig
config SHIELD_CORNE_TPS43_DONGLE
    def_bool $(shields_list_contains,corne_tps43_dongle)

config SHIELD_CORNE_TPS43_LEFT
    def_bool $(shields_list_contains,corne_tps43_left)

config SHIELD_CORNE_TPS43_RIGHT
    def_bool $(shields_list_contains,corne_tps43_right)
```

## config/boards/shields/tps43/Kconfig.defconfig
```kconfig
if SHIELD_TPS43

config ZMK_KEYBOARD_NAME
    default "TPS43"

config ZMK_SPLIT
    default n

endif
```

## input-processor-idle-suppress/Kconfig
```kconfig
config ZMK_INPUT_PROCESSOR_IDLE_SUPPRESS
    bool "Input processor to suppress events during keyboard activity"
    default y
    depends on ZMK_POINTING
    depends on (!ZMK_SPLIT || ZMK_SPLIT_ROLE_CENTRAL)
```

## input-processor-idle-suppress/dts/bindings/zmk,input-processor-idle-suppress.yaml
```yaml
description: |
  Suppress pointing device events when keyboard is active.
  Drops all input events within `idle-timeout-ms` of the last keypress,
  creating an effective dead zone during typing.

compatible: "zmk,input-processor-idle-suppress"

include: ip_one_param.yaml

properties:
  idle-timeout-ms:
    type: int
    required: true
    description: |
      Drop trackball events if a key was pressed within this many milliseconds.
      Typical value: 150-300ms.
```
